## build/conf/bblayers.conf
```bitbake
# POKY_BBLAYERS_CONF_VERSION is increased each time build/conf/bblayers.conf
# changes incompatibly
POKY_BBLAYERS_CONF_VERSION = "2"

BBPATH = "${TOPDIR}"
BBFILES ?= ""

BBLAYERS ?= " \
  ${HOME}/linux_dev/yocto/mkauli_github/poky-dunfell/meta \
  ${HOME}/linux_dev/yocto/mkauli_github/poky-dunfell/meta-poky \
  ${HOME}/linux_dev/yocto/mkauli_github/poky-dunfell/meta-openembedded/meta-oe \
  ${HOME}/linux_dev/yocto/mkauli_github/poky-dunfell/meta-openembedded/meta-networking \
  ${HOME}/linux_dev/yocto/mkauli_github/poky-dunfell/meta-openembedded/meta-perl \
  ${HOME}/linux_dev/yocto/mkauli_github/poky-dunfell/meta-openembedded/meta-python \
  ${HOME}/linux_dev/yocto/mkauli_github/poky-dunfell/meta-security \
  ${HOME}/linux_dev/yocto/mkauli_github/poky-dunfell/meta-jumpnow \
  ${HOME}/linux_dev/yocto/mkauli_github/bbb/meta-bbb \
  ${HOME}/linux_dev/yocto/mkauli_github/bbb/meta-mkaul \
"
```
